## conf/machine/lunix.conf
```bitbake
#@TYPE: Machine
#@NAME: lunix
#@DESCRIPTION: Machine configuration for the qviart lunix

IMAGEDIR ?= "update/purehdse/cfe"

BRANDTYPE = "QVIART"

CHIPSET = "bcm73625"

require conf/machine/include/qviart.inc
```
